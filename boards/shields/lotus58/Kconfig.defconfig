## boards/shields/lotus58/Kconfig.defconfig
```kconfig
## -----------------------------------------------------------------
if SHIELD_LOTUS58_DONGLE

config ZMK_KEYBOARD_NAME
    default "Sofle"

config ZMK_SPLIT_ROLE_CENTRAL
    default y

config ZMK_SPLIT_BLE_CENTRAL_PERIPHERALS
    default 2

config BT_MAX_CONN
    default 7

config BT_MAX_PAIRED
    default 7

config ZMK_STUDIO
    default y

config ZMK_STUDIO_LOCKING
    default n  

config ZMK_SLEEP
    default n
    
endif ## SHIELD_LOTUS58_DONGLE
## -----------------------------------------------------------------
if SHIELD_LOTUS58_LEFT || SHIELD_LOTUS58_RIGHT

config ZMK_SPLIT_ROLE_CENTRAL
    default n

endif ## SHIELD_LOTUS58_LEFT || SHIELD_LOTUS58_RIGHT
## -----------------------------------------------------------------
if SHIELD_LOTUS58_DONGLE || SHIELD_LOTUS58_LEFT || SHIELD_LOTUS58_RIGHT

config ZMK_BLE
    default y

config ZMK_SPLIT
    default y

config ZMK_SLEEP
    default y
```

## config/west.yml
```yaml
manifest:
  remotes:
    - name: zmkfirmware
      url-base: https://github.com/zmkfirmware
      # https://docs.zephyrproject.org/3.2.0/develop/west/manifest.html#projects
    - name: mctechnology17
      url-base: https://github.com/mctechnology17
  projects:
    - name: zmk
      remote: zmkfirmware
      revision: v0.2
      import: app/west.yml
  self:
    path: config
```
